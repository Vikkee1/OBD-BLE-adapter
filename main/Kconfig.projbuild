## main/Kconfig.projbuild
```kconfig
menu "OBD-BLE Adapter"

    config OBD_CAN_TX_GPIO
        int "CAN TX GPIO (to transceiver)"
        default 5
        help
            GPIO connected to the CAN transceiver's TX input.

    config OBD_CAN_RX_GPIO
        int "CAN RX GPIO (from transceiver)"
        default 4
        help
            GPIO connected to the CAN transceiver's RX output.

    config OBD_LED_GPIO
        int "WS2812 status LED GPIO"
        default 48
        help
            GPIO driving the onboard WS2812 status LED. Defaults to the
            ESP32-S3-DevKitC-1 addressable RGB LED pin; override for other
            boards/targets (see sdkconfig.defaults.<target>).

endmenu
```
